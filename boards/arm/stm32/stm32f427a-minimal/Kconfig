## boards/arm/stm32/stm32f427a-minimal/Kconfig
```kconfig
#
# For a description of the syntax of this configuration file,
# see the file kconfig-language.txt in the NuttX tools repository.
#

if ARCH_BOARD_STM32F427A_MINIMAL

# config STM32F427A_FLASH
# 	bool "MTD driver for external 8Mbyte SST25 FLASH on SPI4"
# 	default n
# 	select MTD
# 	select MTD_BYTE_WRITE
# 	---help---
# 		Configures an MTD device for use with the onboard flash

# config STM32F427A_FLASH_MINOR
# 	int "Minor number for the FLASH /dev/smart entry"
# 	default 0
# 	depends on STM32F427A_FLASH
# 	---help---
# 		Sets the minor number for the FLASH MTD /dev entry

# config STM32F427A_FLASH_PART
# 	bool "Enable partition support on FLASH"
# 	default n
# 	depends on STM32F427A_FLASH
# 	---help---
# 		Enables creation of partitions on the FLASH

# config STM32F427A_FLASH_CONFIG_PART
# 	bool "Create application config data partition on FLASH"
# 	default y
# 	depends on STM32F427A_FLASH_PART
# 	depends on PLATFORM_CONFIGDATA
# 	---help---
# 		Enables creation of a /dev/config partition on the FLASH

# config STM32F427A_FLASH_CONFIG_PART_NUMBER
# 	int "Index number of config partition (in list below)"
# 	default 0
# 	depends on STM32F427A_FLASH_CONFIG_PART
# 	---help---
# 		Specifies the index number of the config data partition
# 		from the partition list.

# config STM32F427A_FLASH_PART_LIST
# 	string "Flash partition size list"
# 	default "4,8188"
# 	depends on STM32F427A_FLASH_PART
# 	---help---
# 		Comma separated list of partition sizes in KB.

# config STM32F427A_FLASH_PART_NAMES
# 	string "Flash partition name list"
# 	default "config,rfs"
# 	depends on STM32F427A_FLASH_PART
# 	depends on MTD_PARTITION_NAMES
# 	---help---
# 		Comma separated list of partition names.

config STM32F427A_HIGHPRI
	bool "High priority interrupt test"
	default n

endif # ARCH_BOARD_STM32F427A
```
